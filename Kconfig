## Kconfig
```kconfig
menu "gas"
    menuconfig COMMON_GAS
        bool "Common gas"
        default n
        select DRIVERS_GAS_BOSCH_BME688
	select DRIVERS_GAS_BOSCH_BME688
        ---help---
            Enable default set of gas drivers
    rsource "*/Kconfig"
endmenu #gas
```

## bme688/Kconfig
```kconfig
menuconfig DRIVERS_GAS_BME688
	bool "bme688"
	default n
	---help---
		Enable support for bme688
```
